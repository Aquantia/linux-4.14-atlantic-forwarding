## drivers/net/ethernet/aquantia/Kconfig
```kconfig
# SPDX-License-Identifier: GPL-2.0-only
#
# aQuantia device configuration
#

config NET_VENDOR_AQUANTIA
	bool "aQuantia devices"
	default y
	help
	  Set this to y if you have an Ethernet network cards that uses the aQuantia
	  AQC107/AQC108 chipset.

	  This option does not build any drivers; it causes the aQuantia
	  drivers that can be built to appear in the list of Ethernet drivers.


if NET_VENDOR_AQUANTIA

config AQTION
	tristate "aQuantia AQtion(tm) Support"
	depends on PCI
	depends on MACSEC || MACSEC=n
	help
	  This enables the support for the aQuantia AQtion(tm) Ethernet card.

config AQFWD
	tristate "aQuantia Forwarding driver"
	depends on PCI && (X86_64 || ARM64 || ARM)
	help
	  This enables the aQuantia AQtion(tm) Ethernet forwarding driver which
	  provides high-performance packet forwarding capabilities and offload
	  engine APIs for hardware acceleration. The driver supports direct ring
	  access for user-space applications, zero-copy packet forwarding, and
	  hardware-accelerated network processing through dedicated forwarding
	  rings separate from the standard network interface.

	  This driver is designed for applications requiring high throughput and
	  low latency packet processing, such as network appliances, routers,
	  and specialized networking software that benefits from hardware offload
	  capabilities.

	  Additional features include netlink-based control interface, configurable
	  buffer allocation for Rx/Tx forwarding rings, and integration with the
	  Linux networking stack for hybrid forwarding scenarios.

	  Say Y if you need high-performance packet forwarding or hardware offload
	  capabilities with aQuantia AQtion Ethernet cards. Say M to build as a
	  module. Say N if you only need standard Ethernet functionality.

source "drivers/net/ethernet/aquantia/atlantic-fwd/Kconfig"

endif # NET_VENDOR_AQUANTIA
```

## drivers/net/ethernet/aquantia/atlantic-fwd/Kconfig
```kconfig
#
# Aquantia atlantic-forwarding driver config
#

if AQFWD

config ATLFWD_FWD
       bool "Enable forwarding-engine API"
       default n
       help

         Enable the forwarding-engine API that provides direct hardware access
         for high-performance packet processing applications. This API allows
         user-space applications and kernel modules to bypass the standard
         network stack and directly interact with the hardware forwarding
         rings for zero-copy packet transmission and reception.

         The forwarding-engine API provides:
         - Direct ring buffer access for minimal latency packet processing
         - Hardware-accelerated packet forwarding capabilities
         - Custom packet classification and filtering
         - Integration with user-space networking frameworks
         - Support for specialized networking applications

         This feature is essential for applications that require maximum
         throughput and minimum latency, such as network function virtualization
         (NFV), software-defined networking (SDN), packet inspection, and
         high-frequency trading applications.

         If you are building a general-purpose system or don't need specialized
         packet forwarding capabilities, say N. Say Y only if you specifically
         need direct hardware access for high-performance networking applications.

config ATLFWD_FWD_RXBUF
       int
       prompt "Rx buffer space for forwarding engine's rings" if ATLFWD_FWD
       range 0 320
       default 160 if ATLFWD_FWD
       default 0
       help

         Amount of Rx buffer to reserve for the forwarding-engine
         rings. This sets the default value of the fwd_rx_buf_reserve
         module option.

         Value in kiB, 0 to 320, defaults to 160 if forwarding-engine
         API enabled, 0 otherwise.

config ATLFWD_FWD_TXBUF
       int
       prompt "Tx buffer space for forwarding engine's rings" if ATLFWD_FWD
       range 0 160
       default 80 if ATLFWD_FWD
       default 0
       help

         Amount of Tx buffer to reserve for the forwarding-engine
         rings. This sets the default value of the fwd_tx_buf_reserve
         module option.

         Value in kiB, 0 to 320, defaults to 80 if forwarding-engine
         API enabled, 0 otherwise.

config ATLFWD_FWD_NETLINK
        bool "Enable netlink control socket for forwarding engine"
        default y
        depends on ATLFWD_FWD
        help

          Expose forwarding engine APIs over the netlink socket.

endif
```
